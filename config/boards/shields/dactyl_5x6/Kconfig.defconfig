## config/boards/shields/dactyl_5x6/Kconfig.defconfig
```kconfig
if SHIELD_DACTYL_5X6_LEFT

    config ZMK_KEYBOARD_NAME
        default "Dactyl Left"

    config ZMK_SPLIT_ROLE_CENTRAL
        default y

endif

if SHIELD_DACTYL_5X6_LEFT || SHIELD_DACTYL_5X6_RIGHT

    config ZMK_SPLIT
        default y

endif


config PWM
    default y

config LED_PWM
    default y
```

## config/boards/shields/dactyl_5x6/Kconfig.shield
```kconfig
config SHIELD_DACTYL_5X6_LEFT
    def_bool $(shields_list_contains,dactyl_5x6_left)

config SHIELD_DACTYL_5X6_RIGHT
    def_bool $(shields_list_contains,dactyl_5x6_right)
```

## config/west.yml
```yaml
manifest:
  remotes:
    - name: zmkfirmware
      url-base: https://github.com/zmkfirmware
    - name: m165437 # For nice-view-gem
      url-base: https://github.com/M165437 # For nice-view-gem
  projects:
    - name: zmk
      remote: zmkfirmware
      revision: main
      import: app/west.yml
    - name: nice-view-gem # For nice-view-gem
      remote: m165437 # For nice-view-gem
      revision: main # For nice-view-gem
  self:
    path: config
```
